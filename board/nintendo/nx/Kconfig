## board/nintendo/nx/Kconfig
```kconfig
if TARGET_NX

config SYS_BOARD
	default "nx"

config SYS_VENDOR
	default "nintendo"

config SYS_CONFIG_NAME
	default "nx"

endif
```

## configs/nx_defconfig
```kconfig
CONFIG_ARM=y
CONFIG_COUNTER_FREQUENCY=19200000
CONFIG_ARM_SMCCC=y
CONFIG_SYS_L2CACHE_OFF=y
CONFIG_ARCH_TEGRA=y
CONFIG_SYS_TEXT_BASE=0x80080000
CONFIG_SYS_MALLOC_LEN=0x2500000
CONFIG_NR_DRAM_BANKS=2
CONFIG_ENV_SIZE=0x5000
CONFIG_DEFAULT_DEVICE_TREE="tegra210-nx"
CONFIG_SYS_PROMPT="Tegra210 (NX) # "
CONFIG_TEGRA210=y
CONFIG_TEGRA_GPU=y
CONFIG_ARMV8_SEC_FIRMWARE_SUPPORT=y
CONFIG_SEC_FIRMWARE_ARMV8_PSCI=y
# CONFIG_PSCI_RESET is not set
CONFIG_SYS_LOAD_ADDR=0x88000000
CONFIG_ANDROID_BOOT_IMAGE=y
CONFIG_OF_SYSTEM_SETUP=y
CONFIG_USE_PREBOOT=y
CONFIG_SYS_STDIO_DEREGISTER=y
CONFIG_FDT_SIMPLEFB=y
CONFIG_SYS_MAXARGS=64
CONFIG_SYS_PBSIZE=2089
CONFIG_CMD_ADTIMG=y
# CONFIG_CMD_IMI is not set
CONFIG_CMD_DFU=y
CONFIG_CMD_GPIO=y
CONFIG_CMD_I2C=y
CONFIG_CMD_MMC=y
CONFIG_CMD_PCI=y
CONFIG_CMD_EXT4_WRITE=y
CONFIG_OF_LIVE=y
# CONFIG_ENV_IS_IN_MMC is not set
CONFIG_SYS_RELOC_GD_ENV_ADDR=y
CONFIG_DFU_MMC=y
CONFIG_DFU_RAM=y
CONFIG_DFU_SF=y
CONFIG_SYS_DFU_DATA_BUF_SIZE=0x100000
CONFIG_SYS_DFU_MAX_FILE_SIZE=0x2000000
CONFIG_SYS_I2C_TEGRA=y
CONFIG_SF_DEFAULT_SPEED=24000000
CONFIG_PCI=y
CONFIG_PCI_TEGRA=y
# CONFIG_REQUIRE_SERIAL_CONSOLE is not set
CONFIG_SYS_NS16550=y
CONFIG_DM_VIDEO=y
# CONFIG_VIDEO_LOGO is not set
# CONFIG_BACKLIGHT_PWM is not set
# CONFIG_VIDEO_BPP8 is not set
# CONFIG_VIDEO_BPP16 is not set
CONFIG_CONSOLE_ROTATION=y
CONFIG_NO_FB_CLEAR=y
CONFIG_VIDEO_SIMPLE=y
CONFIG_VIDEO_DT_SIMPLEFB=y
CONFIG_OSD=y
CONFIG_VIDEO_BMP_RLE8=y
CONFIG_CC_OPTIMIZE_LIBS_FOR_SPEED=y
# CONFIG_SHA256 is not set
CONFIG_OF_LIBFDT_OVERLAY=y
CONFIG_CMD_INI=y
```
